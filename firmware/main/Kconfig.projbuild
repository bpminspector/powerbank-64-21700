## firmware/main/Kconfig.projbuild
```kconfig
menu "PowerBank64 monitor"

config PB_I2C_SDA_GPIO
    int "I2C SDA GPIO"
    range 0 48
    default 8

config PB_I2C_SCL_GPIO
    int "I2C SCL GPIO"
    range 0 48
    default 9

config PB_OLED_I2C_ADDRESS
    int "SSD1306-compatible OLED I2C address (60=0x3C, 61=0x3D)"
    range 60 61
    default 60

config PB_INA226_ADDRESS
    int "INA226 I2C address"
    range 64 79
    default 64

config PB_INA226_SHUNT_UOHM
    int "INA226 shunt resistance in micro-ohms (0 disables current/power)"
    range 0 1000000
    default 0

config PB_INA226_INVERT_CURRENT
    bool "Invert INA226 current sign"
    default n
    help
        Enable if measured discharge current is negative.

config PB_TOUCH_LEFT_GPIO
    int "Up touch-module output GPIO"
    range 0 48
    default 1

config PB_TOUCH_OK_GPIO
    int "OK touch-module output GPIO"
    range 0 48
    default 2

config PB_TOUCH_RIGHT_GPIO
    int "Down touch-module output GPIO"
    range 0 48
    default 4

config PB_TOUCH_ACTIVE_LOW
    bool "Touch-module output is active low"
    default n

config PB_NTC1_GPIO
    int "NTC 1 ADC GPIO"
    range 0 48
    default 5

config PB_NTC2_GPIO
    int "NTC 2 ADC GPIO"
    range 0 48
    default 6

config PB_DHT_GPIO
    int "DHT22 data GPIO"
    range 0 48
    default 47

config PB_TOUCH_LONG_MS
    int "Long-press threshold in milliseconds"
    range 500 5000
    default 2000

endmenu
```

## firmware/sdkconfig.defaults
```kconfig
CONFIG_IDF_TARGET="esp32s3"
CONFIG_COMPILER_OPTIMIZATION_SIZE=y
CONFIG_FREERTOS_HZ=1000
```
